## driver/jeejioxie_esp32c3/chip/storage/partition_table/sdkconfig.defaults
```kconfig
CONFIG_PARTITION_TABLE_CUSTOM=y
CONFIG_PARTITION_TABLE_CUSTOM_FILENAME="ble_wifi_partitions.csv"
CONFIG_PARTITION_TABLE_FILENAME="ble_wifi_partitions.csv"
```
